/dts-v1/;
/plugin/;

#include "blair-qrd-nopmi.dtsi"

/ {
	model = "Qualcomm Technologies, Inc. Blair QRD NOPMI";
	compatible = "qcom,blair-qrd", "qcom,blair", "qcom,qrd";
#ifdef CONFIG_ARCH_SONY_ZAMBEZI
	qcom,msm-id = <507 0x10000>, <578 0x10000>, <647 0x10000>;
#else
	qcom,msm-id = <507 0x10000>, <578 0x10000>;
#endif
	qcom,board-id = <0x1000B 0>;
	qcom,pmic-id-size = <4>;
	qcom,pmic-id = <0x2D 0x0 0x0 0x0>;
};

