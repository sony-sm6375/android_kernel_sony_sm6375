/dts-v1/;
/plugin/;

#include "blairp-mtp-nopmi.dtsi"

/ {
	model = "Qualcomm Technologies, Inc. Blairp MTP NOPMI";
	compatible = "qcom,blairp-mtp", "qcom,blairp", "qcom,mtp";
#ifdef CONFIG_ARCH_SONY_ZAMBEZI
	qcom,msm-id = <565 0x10000>, <628 0x10000>, <647 0x10000>;
#else
	qcom,msm-id = <565 0x10000>, <628 0x10000>;
#endif
	qcom,board-id = <8 0>;
	qcom,pmic-id-size = <4>;
	qcom,pmic-id = <0x2D 0x0 0x0 0x0>;
};

