## drivers/nfc/sn2x0_i2c/Kconfig
```kconfig
#
# near field communication driver configuration
#

config NFC_SN2X0_DEVICES
	tristate "NXP NCI based NFC I2C Slave Driver for SNxxx"
	depends on I2C
	help
	  This enables the NFC driver for SNxxx based devices.
	  This is for I2C connected version. NCI protocol logic
	  resides in the usermode and it has no other NFC dependencies.

	  If unsure, say N.
```

## drivers/nfc/sn2x0_spi/Kconfig
```kconfig
#
# secure element driver configuration
#

config NXP_P73v2_DEVICES
	tristate "Nxp P73 secure element protocol driver (SPI) devices"
	depends on SPI && NFC_SN2X0_DEVICES
	help
	  This enables the Secure Element driver for SNxxx based devices.

	  If unsure, say N.

	  This selects Secure Element support.

	  If you want NFC support, you should say Y here and
	  also to your specific host controller driver.
```

## drivers/nfc/snx0_i2c/Kconfig
```kconfig
#
# Nxp Nci protocol (I2C) devices
#

config NFC_SNX0_DEVICES
        tristate "NXP NCI based NFC I2C Slave Driver for SNxxx"
        depends on I2C
	---help---
	  This enables the NFC driver for SNxxx based devices.
	  This is for I2C connected version. NCI protocol logic
	  resides in the usermode and it has no other NFC dependencies.

	  If unsure, say N.

config NFC_SN1X0_DEVICES
        bool "NXP NCI based NFC I2C Slave Driver for SNxxx"
        depends on NFC_SNX0_DEVICES
	---help---
	  You'll have to say Y if your computer contains an I2C device that
	  you want to use under Linux.

	  You can say N here if you don't have any SPI connected to your computer.

config NFC_SN2X0_DEVICES
	bool "NXP NCI based NFC I2C Slave Driver for SNxxx"
	depends on NFC_SNX0_DEVICES
	help
	  This enables the NFC driver for SNxxx based devices.
	  This is for I2C connected version. NCI protocol logic
	  resides in the usermode and it has no other NFC dependencies.

	  If unsure, say N.
```

## drivers/nfc/snx0_spi/Kconfig
```kconfig
#
# secure element driver configuration
#

config NXP_P73_DEVICES
        tristate "Nxp P73 secure element protocol driver (SPI) devices"
        depends on SPI && NFC_SNX0_DEVICES
	---help---
	  You'll have to say Y if your computer contains an SPI device that
	  you want to use under Linux.

	  You can say N here if you don't have any SPI connected to your computer.

config NXP_P73v1_DEVICES
        bool "Nxp P73 secure element protocol driver (SPI) devices"
        depends on NXP_P73_DEVICES && NFC_SN1X0_DEVICES
	---help---
	  You'll have to say Y if your computer contains an SPI device that
	  you want to use under Linux.

	  You can say N here if you don't have any SPI connected to your computer.

config NXP_P73v2_DEVICES
	bool "Nxp P73 secure element protocol driver (SPI) devices"
	depends on NXP_P73_DEVICES && NFC_SN2X0_DEVICES
	help
	  This enables the Secure Element driver for SNxxx based devices.

	  If unsure, say N.

	  This selects Secure Element support.

	  If you want NFC support, you should say Y here and
	  also to your specific host controller driver.
```
